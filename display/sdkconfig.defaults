## display/sdkconfig.defaults
```kconfig
CONFIG_PARTITION_TABLE_CUSTOM=y
CONFIG_PARTITION_TABLE_FILENAME="main/partitions.csv"
CONFIG_ESP_TLS_PSK_VERIFICATION=y

# Enable DFS support
CONFIG_PM_ENABLE=y
# tickless idle allows CPU to enter light sleep automatically if all tasks sleep
# for at least 3ms (default)
CONFIG_FREERTOS_USE_TICKLESS_IDLE=y
CONFIG_FREERTOS_HZ=1000
# Disable all GPIO at light sleep
CONFIG_GPIO_ESP32_SUPPORT_SWITCH_SLP_PULL=y
CONFIG_PM_SLP_DISABLE_GPIO=y
```

## display/sdkconfig.defaults.esp32c6
```kconfig
# get correct arduino pin
CONFIG_ARDUINO_VARIANT="XIAO_ESP32C6"
# default is 2MB
CONFIG_ESPTOOLPY_FLASHSIZE_4MB=y
CONFIG_ESPTOOLPY_FLASHSIZE="4MB"
```
